/*
 * Demo hoan thanh lan 1 (3/9/2023)
 * He thong: esp8266(sever + dieu khien led matrix max7219) + app(android) +led matrix32x8 max7219
 * esp8266:
    * Mode:
      * Mode 1: emoji + ngay gio
      * Mode 2: chu chay (Doc(du dieu kien) hoac ngang hoac ngau nhien(neu du dieu kien) )
      * Mode 3: dieu khien du lieu tu app
    * Tu ket noi hoac thay doi wifi qua dien thoai 
    * Lay time tu sever NTPClient
  
 */
#include "LedControl.h"
#include <NTPClient.h>
#include <WiFiUdp.h>
#include <ESP8266WiFi.h> 
#include "WiFiManager.h"

#define CLK_PIN   13
#define DATA_PIN  14
#define CS_PIN    12 

WiFiUDP ntpUDP;
NTPClient timeClient(ntpUDP, "pool.ntp.org");
WiFiServer wifiServer(80);
WiFiManager wifiManager;
LedControl lc=LedControl(DATA_PIN,CLK_PIN,CS_PIN,4);

String common_mode="TCS",text="ga con 1 2 3",t_mode="udahtcr",text_ghim,text_emoji="111111111111111111111111111111112222222222222222222222222222222233333333333333333333333333333333";
bool disconect=true,complet_common=false,complet_private=false;
int delaytime=1000,brightness=15,value_common=0,value_private=0,value_mode=0,value_tg=0,value_shift=0;
unsigned long time_before=0,time_t_before=0;
byte byte_tg=B00110000;
const byte heart[8] PROGMEM={B00000110,B00011111,B01111111,B11111110,B11111110,B01111111,B00011111,B00000110};
const byte m_rd[] PROGMEM={B00000000,B10000000,B11000000,B11100000,B11110000,B11111000,B11111100,B11111110,B11111111};
const byte asc_ii[256][8] PROGMEM = {
  { 0x00, 0x00, 0x00, 0x00, 0x00, 0x00, 0x00, 0x00 }, // 0x00
  { 0x7E, 0x81, 0x95, 0xB1, 0xB1, 0x95, 0x81, 0x7E }, // 0x01
  { 0x7E, 0xFF, 0xEB, 0xCF, 0xCF, 0xEB, 0xFF, 0x7E }, // 0x02
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  { 0x00, 0x00, 0x00, 0x00, 0x00, 0x00, 0x00, 0x00 }, // 0xFF
};
const byte vtri_a[10][5]PROGMEM={
  {B00001110,B00001010,B00001010,B00001010,B00001110},
  {B00001000,B00001000,B00001010,B00001100,B00001000},
  {B00001110,B00000010,B00001110,B00001000,B00001110},
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  {B00001110,B00001000,B00001110,B00001010,B00001110}
  };
const byte vtri_b[10][5]PROGMEM={
  {B11100000,B10100000,B10100000,B10100000,B11100000},
  {B10000000,B10000000,B10100000,B11000000,B10000000},
  {B11100000,B00100000,B11100000,B10000000,B11100000},
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  {B11100000,B10000000,B11100000,B10100000,B11100000}
  };
const byte date_b[]PROGMEM={B00000000,B10000000,B11000000,B11100000,B11110000,B11111000};
const byte date_a[]PROGMEM={B00000000,B00000010,B00000011};
const byte arrow[8] PROGMEM={B00000011,B00000110,B00001100,B00011000,B00011000,B00001100,B00000110,B00000011};
void setup(){
  Serial.begin(115200);
  for (int i=0;i<4;i++){
    lc.shutdown(i,false);
    lc.setScanLimit(i,8);
    lc.setIntensity(i,8);
    lc.clearDisplay(i);
  }
  while(!wifiManager.autoConnect()) wifiManager.setAPCallback(configModeCallback);
  timeClient.begin();
  timeClient.setTimeOffset(25200); // Chon mui gio = 3600*GMT
  wifiServer.begin();
}
/////////////////////////////////////////////
void loop(){
  while(WiFi.isConnected()) {
    getdata();
    checkstatus(common_mode,complet_common,value_common,0);
    run_common(value_common);
  }
  wifiManager.setAPCallback(configModeCallback);
  delay(delaytime/10);
}
//////////////////////////////////////////////
void setup_emoji(){
  time_before=(unsigned long)millis();
  for(int m=0;m<4;m++)
    for(int i=0;i<8;i++)
      lc.setColumn(m,i,text_emoji.charAt(value_mode*32+(m+1)*8-1-i));
  if(value_mode*32==text_emoji.length())  complet_common=true;
  else value_mode++;
}
void emoji_down(){
  time_before=(unsigned long)millis();
  if(value_mode==0) value_mode=57;
  for(int i=0;i<8;i++) 
    lc.setColumn(0,i,(byte)pgm_read_word(&asc_ii[value_mode][7-i])>>value_tg|(byte)pgm_read_word(&asc_ii[value_mode-1][7-i])<<7-value_tg+1);
  value_tg++;
  if(value_tg==8){
    value_mode--;
    value_tg=0;
  }
  if(value_mode<49) complet_private=true;
}
void emoji_up(){
  time_before=(unsigned long)millis();
  if(value_mode==0) value_mode=48;
  for(int i=0;i<8;i++)    
    lc.setColumn(0,i,pgm_read_word(&asc_ii[value_mode][7-i])<<value_tg|(byte)pgm_read_word(&asc_ii[value_mode+1][7-i])>>7-value_tg+1);
  value_tg++;
  if(value_tg==8) {
    value_mode++;
    value_tg=0;
  }
  if(value_mode>56) complet_private=true;
}
void emoji_heart(){
  time_before=(unsigned long)millis();
  for(int i=0;i<8;i++)
    lc.setColumn(0,i,pgm_read_word(&heart[i]));
  value_mode++; 
  if(value_mode==11)  complet_private=true;
}
void emoji_arrow(){
  time_before=(unsigned long)millis();
  for(int m=0;m<8;m++)
    lc.setColumn(0,m,pgm_read_word(&arrow[m])<<value_mode);
  value_mode++;
  if(value_mode==8)  complet_private=true;
}
bool check_space(String nd){
  int a=1;
  nd=" "+nd;
  for(int i=nd.indexOf(' ',a);i<nd.lastIndexOf(' ')+1;i++)
    if(i-a<6) a=i;
    else return false;
  return true;
  }
void text_ud(String nd){
  time_before=(unsigned long)millis();
  if((text_ghim.charAt(text_ghim.length()-1)!=' ')||(text_ghim.length()<1)) text_ghim+="    ";
  if(value_mode==0&&value_private==0) text_ghim=nd;
  String a,b;
  for(int m=value_private;m<text_ghim.indexOf(' ',value_private);m++) a=a+(String) text_ghim.charAt(m);
  for(int m=a.length();m<4;m++) a=a+" ";
  for(int m=text_ghim.indexOf(' ',value_private)+1;m<text_ghim.indexOf(' ',text_ghim.indexOf(' ',value_private)+1);m++) b=b+(String)text_ghim.charAt(m);
  for(int m=b.length();m<4;m++) b=b+" ";
  for(int m=0;m<4;m++)
      for(int i=0;i<8;i++)    
        lc.setColumn(m,i,pgm_read_word(&asc_ii[(int)a.charAt(m)][7-i])<<value_mode|(byte)pgm_read_word(&asc_ii[(int)b.charAt(m)][7-i])>>7-value_mode+2);    
  if(value_mode<7) value_mode++;
  else value_mode=0;
  if(text_ghim.length()-4<value_private) complet_common=true;
  else if(value_mode==0) value_private=text_ghim.indexOf(' ',value_private)+1; 
}
void text_lr(String nd){
  time_before=(unsigned long)millis();
  if(value_mode==0&&value_private==0) text_ghim=nd;
  for(int m=0;m<4;m++){
      for(int i=7;i>value_mode-1;i--)
        lc.setColumn(m,i,pgm_read_word(&asc_ii[(int)text_ghim.charAt(value_private+m)][7-i+value_mode]));
      for(int i=0;value_mode>i;i++)
        lc.setColumn(m,i,pgm_read_word(&asc_ii[(int)text_ghim.charAt(value_private+m+1)][value_mode-i-1]));
      }
  if(value_mode<7) value_mode++;
  else value_mode=0;
  if((text_ghim.charAt(text_ghim.length()-1)!=' ')||(text_ghim.length()<1)) text_ghim+="   ";
  else if(text_ghim.length()-4==value_private) complet_common=true;
  else if(value_mode==0) value_private++; 
}  
void emoji_tetris(){
  time_before=(unsigned long)millis();
  switch(value_mode){
    case 0:
      for(int i=0;i<8;i++)
        lc.setRow(0,i,B00000000);
      value_mode++;
      value_tg=7;
      break;
    case 1:
      lc.setRow(0,value_tg,B00111100);
      if(value_tg<7) lc.setRow(0,value_tg+1,B00000000);
      if(value_tg==0)  value_mode++;
      value_tg--;
      break;
    case 2:
      lc.setRow(0,7,B00010000);
      lc.setRow(0,6,B00011000);
      lc.setRow(0,5,B00001000);
      value_mode++;
      value_tg=7;
      break;
    case 3:
      if(value_tg==5||value_tg==6) byte_tg=byte_tg<<1;
      lc.setRow(0,value_tg,byte_tg);
      lc.setRow(0,value_tg-1,byte_tg>>1);
      if(value_tg<7) lc.setRow(0,value_tg+1,B00000000);
      else lc.setRow(0,5,B00000000);
      if(value_tg==2)  {
        value_mode++;
        value_tg=8;
        byte_tg=B00111100;
      }
      value_tg--;
      break;
    case 4:
      if(value_tg==6) byte_tg=byte_tg>>1;
      if(value_tg<7) lc.setRow(0,value_tg+1,B00000000);
      if(value_tg==1) {
        lc.setRow(0,2,B11000000);
        value_mode++;
        value_tg=8;
        lc.setRow(0,1,B01111110);
      } else lc.setRow(0,value_tg,byte_tg);
      if(value_tg==2) lc.setRow(0,2,B11011110);
      value_tg--;
      break;
    case 5:
      for(int i=7;i>3;i--)
        lc.setRow(0,i,B00001000);
      value_tg=7;
      value_mode++;
      break;
    case 6:
      if(value_tg<7) lc.setRow(0,value_tg+1,B00000000);
      else for(int i=6;i>3;i--)
        lc.setRow(0,i,B00000000);
      if(value_tg==3) lc.setRow(0,value_tg,B00111100);  
      else if(value_tg==2){
        lc.setRow(0,2,B11111100);
        value_mode++;
        value_tg=8;
      }
      else lc.setRow(0,value_tg,B00111100); 
      value_tg--;
      break;
    case 7:
      if(value_tg==6||value_tg==5) value_shift++;
      lc.setRow(0,value_tg,B00001000>>value_shift);
      lc.setRow(0,value_tg-1,B00001000>>value_shift);
      lc.setRow(0,value_tg-2,B00011000>>value_shift);
      if(value_tg<7) lc.setRow(0,value_tg+1,B00000000);
      if(value_tg==5)value_mode++;
      value_tg--;
      break;
    case 8:
      lc.setRow(0,5,B00000000);
      lc.setRow(0,4,B00000001);
      lc.setRow(0,3,B00000001);
      lc.setRow(0,2,B11111111);
      value_mode++;
      value_shift=0;
      value_tg=7;
      break;
    case 9:
      if(value_tg==6||value_tg==5) value_shift++;
      lc.setRow(0,value_tg,B00011000>>value_shift);
      lc.setRow(0,value_tg-1,B00011000>>value_shift);
      if(value_tg==5) lc.setRow(0,value_tg-1,B00000111);
      if(value_tg==4){
        lc.setRow(0,value_tg,B00000111);
        lc.setRow(0,value_tg-1,B00000111);
        value_mode++;
      }
      if(value_tg<7) lc.setRow(0,value_tg+1,B00000000);
      value_tg--;
      break;
    case 10:
      lc.setRow(0,7,B00100000);
      lc.setRow(0,6,B00100000);
      lc.setRow(0,5,B00110000);
      value_mode++;
      break;
    case 11:
      lc.setRow(0,7,B00000000);
      lc.setRow(0,6,B01000000);
      lc.setRow(0,5,B01000000);
      lc.setRow(0,4,B01100111);
      value_mode++;
      break;
    case 12:
      lc.setRow(0,7,B00000000);
      lc.setRow(0,6,B00000000);
      lc.setRow(0,5,B10000000);
      lc.setRow(0,4,B10000111);
      lc.setRow(0,3,B11000111);
      value_mode++;
      break;
    case 13:
      lc.setRow(0,7,B00100000);
      lc.setRow(0,6,B00100000);
      lc.setRow(0,5,B10110000);
      value_mode++;
      break;
    case 14:
      lc.setRow(0,7,B00001000);
      lc.setRow(0,6,B00111000);
      lc.setRow(0,5,B10000000);
      value_mode++;
      break;
    case 15:
      lc.setRow(0,7,B00000000);
      lc.setRow(0,6,B00001000);
      lc.setRow(0,5,B10111000);
      value_mode++;
      break;
    case 16:
      lc.setRow(0,7,B00000000);
      lc.setRow(0,6,B00000000);
      lc.setRow(0,5,B10010000);
      lc.setRow(0,4,B11110111);
      value_mode++;
      break;
    case 17:
      lc.setRow(0,7,B00000100);
      lc.setRow(0,6,B00001110);
      value_mode++;
      break;
    case 18:
      lc.setRow(0,7,B00000000);
      lc.setRow(0,6,B00000010);
      lc.setRow(0,5,B10010111);
      value_mode++;
      break;
    case 19:
      lc.setRow(0,7,B00110000);
      lc.setRow(0,6,B00110010);
      value_mode++;
      break;
    case 20:
      lc.setRow(0,7,B00000000);
      lc.setRow(0,6,B01100010);
      lc.setRow(0,5,B11110111);
      value_mode++;
      break;
    case 21:
      lc.setRow(0,7,B00111000);
      lc.setRow(0,6,B01110010);
      value_mode++;
      break;
    case 22:
      lc.setRow(0,7,B00111100);
      lc.setRow(0,6,B01110010);
      value_mode++;
      break;
    case 23:
      lc.setRow(0,7,B00111100);
      lc.setRow(0,6,B01110110);
      complet_private=true;
      break;
  }
}
void emoji_clock(){
  time_before=(unsigned long)millis();
  byte a[]={B00111100,B01111110,B11111111,B11111111,B11100001,B11111111,B01111110,B00111100};
  switch(value_mode){
    case 0:    
      for(int i=0;i<8;i++)
        lc.setColumn(0,i,a[i]);
      value_mode++;
      break;
    case 1:
      lc.setColumn(0,2,B11111011);
      lc.setColumn(0,3,B11110111);
      lc.setColumn(0,4,B11100001);
      value_mode++;
      break;
    case 2:
      lc.setColumn(0,2,B11101111);
      lc.setColumn(0,3,B11101111);
      lc.setColumn(0,4,B11100001);
      value_mode++;
      break;
    case 3:
      lc.setColumn(0,2,B10111111);
      lc.setColumn(0,3,B11011111);
      lc.setColumn(0,4,B11100001);
      value_mode++;
      break;
    case 4:
      lc.setColumn(0,2,B11111111);
      lc.setColumn(0,3,B11111111);
      lc.setColumn(0,4,B10000001);
      value_mode++;
      break;
    case 5:       
      lc.setColumn(0,6,B01111110);
      lc.setColumn(0,5,B11011111);
      lc.setColumn(0,4,B11100001);
      value_mode++;
      break;
    case 6:
      lc.setColumn(0,6,B01101110);
      lc.setColumn(0,5,B11101111);
      lc.setColumn(0,4,B11100001);
      value_mode++;
      break;
    case 7:
      lc.setColumn(0,5,B11110111);
      lc.setColumn(0,6,B01111010);
      lc.setColumn(0,4,B11100001);
      complet_private=true;
      break;
  }
}
void run_time(){
  timeClient.update();
  display_time(1,timeClient.getHours());
  display_time(2,timeClient.getMinutes());
  display_time(3,timeClient.getSeconds());
  ht_date(1,timeClient.getDay()+1);
  unsigned long epochTime = timeClient.getEpochTime();
  struct tm *ptm = gmtime ((time_t *)&epochTime);
  ht_date(2,ptm->tm_mday);
  ht_date(3,ptm->tm_mon+1);
  time_t_before=(unsigned long)millis();
}
void display_time(int max_7219,int timer){
  int hc,dv;
  hc=timer/10;
  dv=timer-hc*10;
  for(int i=0;i<5;i++)
    lc.setRow(max_7219,i,pgm_read_word(&vtri_a[hc][i]) | pgm_read_word(&vtri_b[dv][i]));
}
void ht_date(int max_7219,int timer){
  int hc=0,dv=0;
  hc=timer/10;
  dv=timer-hc*10;
  int tg=0,tg1=0;
  if(dv>5) tg=dv-5;
  if(hc>2) tg1=hc-2;
  if(max_7219==1){
      lc.setRow(max_7219,7,(pgm_read_word(&date_b[dv-tg]) | pgm_read_word(&date_a[hc-tg1]))>>1);
      lc.setRow(max_7219,6,(pgm_read_word(&date_b[tg])| pgm_read_word(&date_a[tg1]))>>1);
  }
  else{
    lc.setRow(max_7219,7,pgm_read_word(&date_b[dv-tg]) | pgm_read_word(&date_a[hc-tg1]));
    lc.setRow(max_7219,6,pgm_read_word(&date_b[tg])| pgm_read_word(&date_a[tg1]));
  }
}
void mrandom(){
  time_before=(unsigned long)millis();
  if(value_mode<11){
    value_mode++;
    for(int i=0;i<8;i++)
      lc.setColumn(0,i,pgm_read_word(&m_rd[random(0,9)]));
  }
  if(value_mode==11){
    complet_private=true;
  }
}
unsigned long timer(unsigned long before){
  unsigned long timerr=(unsigned long)((unsigned long)millis()-before);
  return timerr;
}
void run_private(int value){
  if(timer(time_t_before)>500)
    run_time();
  switch(t_mode.charAt(value)){
    case 't':
      if(timer(time_before)>delaytime)
        emoji_tetris();
      break;
    case 'r':
      if(timer(time_before)>delaytime)
        mrandom();
      break;
    case 'c':
      if(timer(time_before)>delaytime)
        emoji_clock();   
      break;
    case 'a':
      if(timer(time_before)>delaytime)
        emoji_arrow();   
      break;
    case 'h':
      if(timer(time_before)>delaytime)
        emoji_heart();   
      break;   
    case 'd':
      if(timer(time_before)>delaytime/4)
        emoji_down();   
      break;
    case 'u':
      if(timer(time_before)>delaytime/4)
        emoji_up();   
      break;      
  }
}
void run_common(int value){
  switch(common_mode.charAt(value)){
    case 'T':
      run_private(value_private);
      checkstatus(t_mode,complet_private,value_private,1);
      break;
    case 'C':
      if(value_shift==0&&check_space(text)) value_shift=random(1,3);
      else if(value_shift==0&&!check_space(text))  value_shift=1;
      if(value_shift==1&&timer(time_before)>delaytime/5)
        text_lr(text);
      if(value_shift==2&&timer(time_before)>delaytime/5)
        text_ud(text);
      break;
    case 'S':
      if(timer(time_before)>delaytime*2)
        setup_emoji(); 
      break;
    case 'E':
      complet_common=true;
      Serial.println("E");
      break;
  }
}
void checkstatus(String list_mode,bool complet,int value,int c_p){ 
  if(complet&&value<(list_mode.length()-1)){ 
    if(c_p==0){
      complet_common=false;
      complet_private=false;
      value_common++;
      value_private=0;
      for(int i=0;i<4;i++)
        lc.clearDisplay(i);  
    } else{
      complet_private=false;
      complet_common=false;
      value_private++;
    }
    value_mode=0;
    value_shift=0;
    byte_tg=B00110000;
    value_tg=7;  
  } else if(complet&&value==(list_mode.length()-1)){
    if(c_p==0){
      complet_common=false;
      complet_private=false;
      value_common=0;
      value_private=0;
      for(int i=0;i<4;i++)
        lc.clearDisplay(i);  
    } else{
      complet_private=false;
      complet_common=true;
      value_private=0;   
    }
    value_mode=0;
    byte_tg=B00110000;
    value_tg=7;
    value_shift=0;
  }
}
void configModeCallback (WiFiManager *myWiFiManager){
  wifiManager.autoConnect();
  Serial.println("Entered config mode");
  Serial.println(WiFi.softAPIP());
  Serial.println(myWiFiManager->getConfigPortalSSID()); 
}
void getdata(){
  WiFiClient client = wifiServer.available();
  String data=" ";
  if (client&&client.connected()) {
     while (client.available()>0) {
       char buf = client.read();
       data=data+(String)buf;
       if(data.lastIndexOf("$")!=-1){
          data.trim();
          data.replace("$","");
          edit_parameter(data);
          }
     }
     client.println((String)delaytime+" "+(String)brightness+" "+common_mode+" "+text+" "+t_mode);
     disconect=false;
  }
  else if(disconect)  delay(50);
  else if(!client){
    client.stop();
    disconect=true;
  }
}
void edit_parameter(String buff){
  Serial.println(buff);
  if(buff.startsWith("time:")){ 
      buff.replace("time:","");
      String a=buff;
      delaytime=a.toInt();
  } else if((buff.startsWith("brightness:"))){
      buff.replace("brightness:","");
      String a=buff;
      brightness=a.toInt();
  } else if((buff.startsWith("common_mode:"))){
      buff.replace("common_mode:","");
      common_mode=buff;
  } else if((buff.startsWith("text:"))){
      buff.replace("text:","");
      text=buff;
  } else if((buff.startsWith("t_mode:"))){
      buff.replace("t_mode:","");
      t_mode=buff;
  } else if((buff.startsWith("text_emoji:"))){
      buff.replace("text_emoji:","");
      text_emoji=buff;  
    }
}
